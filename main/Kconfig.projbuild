## main/Kconfig.projbuild
```kconfig
menu "Example Configuration"

menu "I2C Master"
    config I2C_MASTER_SCL
    int "SCL GPIO Num"
    default 19
    help
        GPIO number for I2C Master clock line.

config I2C_MASTER_SDA
    int "SDA GPIO Num"
    default 18
    help
        GPIO number for I2C Master data line.

config I2C_MASTER_PORT_NUM
    int "Port Number"
    default 1
    help
        Port number for I2C Master device.

config I2C_MASTER_FREQUENCY
    int "Master Frequency"
    default 100000
    help
        I2C Speed of Master device.
endmenu

menu "MQTT Broker"

config BROKER_URL
    string "Broker URL"
    default "mqtt://io.adafruit.com"
    help
        URL for MQTT Broker
endmenu

endmenu
```
